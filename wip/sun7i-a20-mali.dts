/dts-v1/;
/plugin/;

/ {
	compatible = "allwinner,sun7i-a20";

	fragment@0 {
		target-path = "/soc@1c00000/";
		__overlay__ {
			mali: gpu@1c40000 {
				"allwinner,sun7i-a20-mali", "arm,mali-400";
				reg = <0x01c40000 0x10000>;
				interrupts = <0 97 4>,
					     <0 98 4>,
					     <0 99 4>,
					     <0 100 4>,
					     <0 102 4>,
					     <0 103 4>,
					     <0 101 4>;
				interrupt-names = "gp",
						  "gpmmu",
						  "pp0",
						  "ppmmu0",
						  "pp1",
						  "ppmmu1",
						  "pmu";
				clocks = <&ccu CLK_BUS_GPU>, <&ccu CLK_GPU>;
				clock-names = "bus", "core";
				resets = <&ccu RST_BUS_GPU>;
				#cooling-cells = <2>;

				assigned-clocks = <&ccu CLK_GPU>;
				assigned-clock-rates = <384000000>;
			};
		};
	};

};
