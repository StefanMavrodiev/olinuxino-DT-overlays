/dts-v1/;
/plugin/;

/ {
	compatible = "allwinner,sun7i-a20";

	fragment@0 {
		target = <&i2c2>;
		__overlay__ {
			atecc508a@60 {
				compatible = "atmel,atecc508a";
				reg = <0x60>;
			};
		};
	};
};
